## CMakeLists.txt
```
cmake_minimum_required(VERSION 3.20.0)

#set(BOARD nrf7002dk_nrf5340_cpuapp)
set(BOARD nrf7002dk/nrf5340/cpuapp)

#set(BOARD nucleo_h743zi)

find_package(Zephyr)

project(mcuboot)
generate_inc_file_for_target(app data.json data.bin)

target_sources(app PRIVATE src/main.c)
```

## prj.conf
```kconfig
CONFIG_LOG=y
CONFIG_SHELL=y
CONFIG_REBOOT=y
CONFIG_FLASH=y
CONFIG_FLASH_MAP=y
CONFIG_FILE_SYSTEM=y
CONFIG_FILE_SYSTEM_SHELL=y
CONFIG_FILE_SYSTEM_LITTLEFS=y


# Add 256 bytes to accommodate upload command (lfs_stat overflows)
CONFIG_SYSTEM_WORKQUEUE_STACK_SIZE=2304

# Enable file system commands
# CONFIG_MCUMGR_GRP_FS=y
CONFIG_FLASH_PAGE_LAYOUT=y
CONFIG_FS_LOG_LEVEL_DBG=y
CONFIG_HEAP_MEM_POOL_SIZE=16384
CONFIG_SHELL_LOG_LEVEL_INF=y
CONFIG_SHELL_LOG_LEVEL_DBG=y

CONFIG_DEBUG=y

CONFIG_SHELL_BACKEND_SERIAL_RX_RING_BUFFER_SIZE=128


# To have the flash shell command 

CONFIG_FLASH_SHELL=y
CONFIG_FLASH_SHELL_TEST_COMMANDS=y
```

## app.overlay
```dts
/ {
	fstab {
		compatible = "zephyr,fstab";
		status="okay";
		lfs1: lfs1 {
			compatible = "zephyr,fstab,littlefs";
			status="okay";
			read-size = <32>;
			prog-size = <32>;
			cache-size = <256>;
			lookahead-size = <64>;
			block-cycles = <512>;
			partition = <&storage_partition>;
			mount-point = "/lfs1";
		};
	};
};




&power {
	status = "disabled";
};
```

## src/main.c
```c
#include<zephyr/kernel.h>
#include<zephyr/logging/log.h>

int main()
{
    while(1)
    {
        k_msleep(5000);
        k_msleep(1000);
        
    }
}
```
